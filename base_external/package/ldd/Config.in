## base_external/package/ldd/Config.in
```kconfig
config BR2_PACKAGE_LDD
	bool "ldd"
	help
	  Build and install the misc-modules and scull components from https://github.com/cu-ecen-aeld/ldd3.git.
```
